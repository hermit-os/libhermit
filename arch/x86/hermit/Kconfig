## arch/x86/hermit/Kconfig
```kconfig
config HERMIT_CORE
	bool "HermitCore support"
	depends on X86_64
	depends on HOTPLUG_CPU
	select SYSFS
	---help---
	  HermitCore is a lightweight extreme-scale kernel, which isolates
	  cores from Linux and use it for bare-metal computation.
```

## linux/arch/x86/hermit/Kconfig
```kconfig
config HERMIT_CORE
	bool "HermitCore support"
	depends on X86_64
	depends on HOTPLUG_CPU
	select SYSFS
	---help---
	  HermitCore is a lightweight extreme-scale kernel, which isolates
	  cores from Linux and use it for bare-metal computation.

config HERMIT_SIZE
	hex "Memory size of HermitCore"
	default "0xA00000"
	depends on HERMIT_CORE
	---help---
	  Set the default size of HermitCore's self-governed memory
```
